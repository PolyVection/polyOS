## build/conf/bblayers.conf
```bitbake
# POKY_BBLAYERS_CONF_VERSION is increased each time build/conf/bblayers.conf
# changes incompatibly
POKY_BBLAYERS_CONF_VERSION = "2"

BBPATH = "${TOPDIR}"
BSPDIR := "${@os.path.abspath(os.path.dirname(d.getVar('FILE', True)) + '/../..')}"
BBFILES ?= ""

BBLAYERS += " ${BSPDIR}/sources/poky/meta "
BBLAYERS += " ${BSPDIR}/sources/poky/meta-poky "
BBLAYERS += " ${BSPDIR}/sources/poky/meta-yocto-bsp "
BBLAYERS += " ${BSPDIR}/sources/meta-openembedded/meta-oe "
BBLAYERS += " ${BSPDIR}/sources/meta-openembedded/meta-networking "
BBLAYERS += " ${BSPDIR}/sources/meta-openembedded/meta-multimedia "
BBLAYERS += " ${BSPDIR}/sources/meta-openembedded/meta-filesystems "
BBLAYERS += " ${BSPDIR}/sources/meta-openembedded/meta-python "
BBLAYERS += " ${BSPDIR}/sources/meta-polyos "
BBLAYERS += " ${BSPDIR}/sources/meta-freescale "
```

## build/conf/local.conf
```bitbake
MACHINE = "voltastream"
DISTRO = "polyos"
BSPDIR := "${@os.path.abspath(os.path.dirname(d.getVar('FILE', True)) + '/../..')}"
DL_DIR ?= "${BSPDIR}/downloads"
SSTATE_DIR ?= "${BSPDIR}/sstate-cache"
BB_NUMBER_THREADS = "8"
PARALLEL_MAKE = "-j 8"
LICENSE_FLAGS_WHITELIST += "commercial"
INSANE_SKIP_snapcast_append = "already-stripped"
INSANE_SKIP_slimserver_append = "already-stripped"
EXTRA_IMAGE_FEATURES = "debug-tweaks"
```

## sources/meta-polyos/conf/layer.conf
```bitbake
# We have a conf and classes directory, add to BBPATH
BBPATH .= ":${LAYERDIR}"

# We have a packages directory, add to BBFILES
BBFILES += "${LAYERDIR}/recipes-*/*/*.bb \
            ${LAYERDIR}/recipes-*/*/*.bbappend"

BBFILE_COLLECTIONS += "polyvection"
BBFILE_PATTERN_polyvection := "^${LAYERDIR}/"
BBFILE_PRIORITY_polyvection = "6"
```

## sources/meta-polyos/conf/machine/include/sun50i-pv.inc
```bitbake
require conf/machine/include/sunxi64-pv.inc
require conf/machine/include/arm/arch-armv8.inc

SOC_FAMILY = "sun50i"
```

## sources/meta-polyos/conf/machine/include/sunxi64-pv.inc
```bitbake
SOC_FAMILY ??= ""
include conf/machine/include/soc-family.inc

PREFERRED_PROVIDER_virtual/kernel ?= "linux-mainline-pv"
PREFERRED_PROVIDER_u-boot ?= "u-boot-mainline-pv"
PREFERRED_PROVIDER_virtual/bootloader ?= "u-boot-mainline-pv"

KERNEL_IMAGETYPE ?= "Image"

IMAGE_CLASSES += "image_types_sunix_pv"
IMAGE_FSTYPES += "ext4 tar.gz sdcard"

MACHINE_EXTRA_RRECOMMENDS = "kernel-modules"

UBOOT_LOCALVERSION = "-g${@d.getVar('SRCPV', True).partition('+')[2][0:7]}"

UBOOT_ENTRYPOINT ?= "0x40008000"
UBOOT_LOADADDRESS ?= "0x400080OB00"

UBOOT_BINARY ?= "u-boot.itb"
SPL_BINARY ?= "spl/sunxi-spl.bin"

SERIAL_CONSOLE ?= "115200 ttyS0"
MACHINE_FEATURES ?= "alsa apm keyboard rtc serial screen usbgadget usbhost vfat"
```

## sources/meta-polyos/conf/machine/voltastream-a64.conf
```bitbake
#@TYPE: Machine
#@NAME: voltastream-a64
#@DESCRIPTION: Machine configuration for the VoltaStream boards based
# on the Allwinner A64 SoC.

require conf/machine/include/sun50i-pv.inc

PREFERRED_VERSION_u-boot = "v2018.09%"

KERNEL_DEVICETREE = "allwinner/sun50i-a64-olinuxino.dtb"
UBOOT_MACHINE = "a64-voltastream_defconfig"
```

## sources/meta-polyos/conf/machine/voltastream.conf
```bitbake
#@TYPE: Machine
#@NAME: PolyVection VoltaStream boards
#@SOC: i.MX6ULL
#@DESCRIPTION: Machine configuration for PolyVection VoltaStream boards
#@MAINTAINER: Philip Voigt <info@polyvection.com>

include conf/machine/include/imx-base-pv.inc
include conf/machine/include/tune-cortexa7.inc
include conf/machine/include/imx6ul-common.inc

# MACHINE_FIRMWARE_append = " firmware-imx-epdc firmware-imx-brcm"

SOC_FAMILY = "mx6ul:mx6ull"

KERNEL_DEVICETREE = "imx6ull-voltastream0.dtb"
KERNEL_DEVICETREE += " imx6ull-voltastream-amp1.dtb"
KERNEL_DEVICETREE += " imx6ull-vsm1-0006.dtb"
KERNEL_DEVICETREE += " imx6ull-vsm1-0007.dtb"

UBOOT_CONFIG ??= "sd"
UBOOT_CONFIG[sd] = "mx6ull_voltastream0_config,sdcard"
```
